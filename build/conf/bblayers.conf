## build/conf/bblayers.conf
```bitbake
# POKY_BBLAYERS_CONF_VERSION is increased each time build/conf/bblayers.conf
# changes incompatibly
POKY_BBLAYERS_CONF_VERSION = "2"

BBPATH = "${TOPDIR}"
BBFILES ?= ""

BBLAYERS ?= " \
  /home/mcholewa/yocto-projects/bbb-verified-boot/poky/meta \
  /home/mcholewa/yocto-projects/bbb-verified-boot/poky/meta-poky \
  /home/mcholewa/yocto-projects/bbb-verified-boot/poky/meta-yocto-bsp \
  /home/mcholewa/yocto-projects/bbb-verified-boot/meta-arm/meta-arm-toolchain \
  /home/mcholewa/yocto-projects/bbb-verified-boot/meta-arm/meta-arm \
  /home/mcholewa/yocto-projects/bbb-verified-boot/meta-ti/meta-ti-bsp \
  /home/mcholewa/yocto-projects/bbb-verified-boot/meta-ti/meta-ti-extras \
  /home/mcholewa/yocto-projects/bbb-verified-boot/meta-openembedded/meta-oe \
  /home/mcholewa/yocto-projects/bbb-verified-boot/meta-openembedded/meta-python \
  /home/mcholewa/yocto-projects/bbb-verified-boot/meta-openembedded/meta-networking \
  /home/mcholewa/yocto-projects/bbb-verified-boot/meta-custom \
  "
```
